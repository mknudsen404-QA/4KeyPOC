#ifndef SWITCHBOARD_STATUS_TABLE_H
#define SWITCHBOARD_STATUS_TABLE_H

// GENERATED by host/switchboard/status_table.py --emit-header. Do not
// hand-edit — edit STATUSES in that file and regenerate:
//   python3 -m switchboard.status_table --emit-header > firmware/neokey/status_table.h

#include <cstdint>
#include <cstring>

enum class Status : uint8_t {
  Empty,
  Launched,
  Idle,
  Thinking,
  Working,
  Waiting,
  NeedsInput,
  Blocked,
  Done,
  Unknown,
};

inline Status statusFromString(const char *s) {
  if (strcmp(s, "empty") == 0) return Status::Empty;
  if (strcmp(s, "launched") == 0) return Status::Launched;
  if (strcmp(s, "idle") == 0) return Status::Idle;
  if (strcmp(s, "thinking") == 0) return Status::Thinking;
  if (strcmp(s, "working") == 0) return Status::Working;
  if (strcmp(s, "waiting") == 0) return Status::Waiting;
  if (strcmp(s, "needs_input") == 0) return Status::NeedsInput;
  if (strcmp(s, "blocked") == 0) return Status::Blocked;
  if (strcmp(s, "done") == 0) return Status::Done;
  return Status::Unknown;
}

inline bool statusIsBusy(Status s) {
  return s == Status::Thinking || s == Status::Working;
}

constexpr uint32_t SOFT_WHITE = 0x8C8C8C;  // launched + idle, and the busy ramp's starting color

inline uint32_t colorForStatus(Status s) {
  switch (s) {
    case Status::Empty: return 0x000000;
    case Status::Launched: return 0x8C8C8C;
    case Status::Idle: return 0x8C8C8C;
    case Status::Thinking: return SOFT_WHITE;  // busy ramp overrides this — see busyColor()
    case Status::Working: return SOFT_WHITE;  // busy ramp overrides this — see busyColor()
    case Status::Waiting: return 0xFFFF00;
    case Status::NeedsInput: return 0xFFFF00;
    case Status::Blocked: return 0xFF0000;
    case Status::Done: return 0x00FF00;
    case Status::Unknown: return 0xFF8C00;
    default: return 0;
  }
}

// Static (non-ramp) per-status pulse period in ms; 0 means "solid, no
// pulse". Busy statuses (Thinking/Working) aren't listed here — they use
// busyPulsePeriodMs()'s ramp instead (see led_model.h's pulsePeriodFor()).
inline unsigned long staticPulseMsFor(Status s) {
  switch (s) {
    case Status::NeedsInput: return 500UL;
    case Status::Unknown: return 3000UL;
    default: return 0UL;
  }
}

#endif  // SWITCHBOARD_STATUS_TABLE_H
